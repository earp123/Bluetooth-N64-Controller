## prj.conf
```kconfig
#
# Copyright (c) 2019 Nordic Semiconductor ASA
#
# SPDX-License-Identifier: LicenseRef-Nordic-5-Clause
#
CONFIG_NCS_SAMPLES_DEFAULTS=y

CONFIG_BT=y
#CONFIG_BT_DEBUG_LOG=y
CONFIG_BT_CENTRAL=y
CONFIG_BT_SMP=y
CONFIG_BT_GATT_CLIENT=y
CONFIG_BT_GATT_DM=y
CONFIG_HEAP_MEM_POOL_SIZE=8192
CONFIG_MAIN_STACK_SIZE=8192

CONFIG_UART_ASYNC_API=y

CONFIG_BT_SCAN=y
CONFIG_BT_SCAN_FILTER_ENABLE=y
CONFIG_BT_SCAN_UUID_CNT=1
CONFIG_BT_PRIVACY=y
CONFIG_BT_PHY_UPDATE=y
CONFIG_BT_RX_STACK_SIZE=9600

CONFIG_BT_SETTINGS=y
CONFIG_FLASH=y
CONFIG_FLASH_PAGE_LAYOUT=y
CONFIG_FLASH_MAP=y
CONFIG_NVS=y
CONFIG_SETTINGS=y

CONFIG_DK_LIBRARY=y
```

## src/main.c
```c
/*
 * Copyright (c) 2019 Nordic Semiconductor ASA
 *
 * SPDX-License-Identifier: LicenseRef-Nordic-5-Clause
 */

/** @file
 *  @brief Nordic Battery Service Client sample
 */

#include <zephyr/types.h>
#include <stddef.h>
#include <inttypes.h>
#include <errno.h>
#include <zephyr/kernel.h>
#include <zephyr/sys/printk.h>

#include <zephyr/bluetooth/bluetooth.h>
#include <zephyr/bluetooth/hci.h>
#include <zephyr/bluetooth/conn.h>
#include <zephyr/bluetooth/uuid.h>
#include <zephyr/bluetooth/gatt.h>
#include <bluetooth/gatt_dm.h>
#include <bluetooth/scan.h>

#include <zephyr/drivers/uart.h>

#include <dk_buttons_and_leds.h>

#include "joybus_client.h"

#include <zephyr/settings/settings.h>

/**
 * Button to read the battery value
 */
#define KEY_READVAL_MASK DK_BTN1_MSK

#define BAS_READ_VALUE_INTERVAL (10 * MSEC_PER_SEC)

#define BT_LE_JOYBUS_CONN_PARAMS BT_LE_CONN_PARAM(0x08, 0x09, 0, 400)

#define UART_TX_BUFF_SIZE 4

#define WORKQ_THREAD_STACK_SIZE 1024
#define WORKQ_PRIORITY 4

static bool bt_connected = false;

// Define stack area used by workqueue thread
static K_THREAD_STACK_DEFINE(my_stack_area, WORKQ_THREAD_STACK_SIZE);

// Define the message queue for BT to uart data
K_MSGQ_DEFINE(uart_queue, sizeof(uint32_t), 1, 4);

//UART1 named as uart throughout the code
const struct device *uart= DEVICE_DT_GET(DT_NODELABEL(uart1));

/*Define the receive buffer */
static uint8_t tx_buf[UART_TX_BUFF_SIZE] = {0};

// Define queue structure
static struct k_work_q offload_work_q = {0};

static struct bt_conn *default_conn;
static struct bt_joybus_client joy;

static void notify_input_rsp_cb(struct bt_joybus_client *joy,
				    uint32_t input_response);

static void read_input_response_cb(struct bt_joybus_client *joy,
				  uint32_t input_response,
				  int err);

static void app_button_indicated_cb(struct bt_joybus_client *joy, uint8_t button_state);

uint32_t led_write_state = -1;

struct work_info {
    struct k_work work;
    char name[25];
} my_work;

void offload_function(struct k_work *work_term)
{
	if(!(led_write_state < 0)){
		if (led_write_state & KEY_READVAL_MASK) {
			joybus_led_write(&joy, 0x0001);
		}
		else {
			joybus_led_write(&joy, 0);
		}
	}
	else {
		//invlaid led_write_state value
	}
	
}

static void scan_filter_match(struct bt_scan_device_info *device_info,
			      struct bt_scan_filter_match *filter_match,
			      bool connectable)
{
	char addr[BT_ADDR_LE_STR_LEN];

	bt_addr_le_to_str(device_info->recv_info->addr, addr, sizeof(addr));

	printk("Filters matched. Address: %s connectable: %s\n",
		addr, connectable ? "yes" : "no");
}

static void scan_connecting_error(struct bt_scan_device_info *device_info)
{
	printk("Connecting failed\n");
}

static void scan_connecting(struct bt_scan_device_info *device_info,
			    struct bt_conn *conn)
{
	default_conn = bt_conn_ref(conn);
}

static void scan_filter_no_match(struct bt_scan_device_info *device_info,
				 bool connectable)
{
	int err;
	struct bt_conn *conn;
	char addr[BT_ADDR_LE_STR_LEN];

	if (device_info->recv_info->adv_type == BT_GAP_ADV_TYPE_ADV_DIRECT_IND) {
		bt_addr_le_to_str(device_info->recv_info->addr, addr,
				  sizeof(addr));
		printk("Direct advertising received from %s\n", addr);
		bt_scan_stop();

		err = bt_conn_le_create(device_info->recv_info->addr,
					BT_CONN_LE_CREATE_CONN,
					device_info->conn_param, &conn);

		if (!err) {
			default_conn = bt_conn_ref(conn);
			bt_conn_unref(conn);
		}
	}
}

BT_SCAN_CB_INIT(scan_cb, scan_filter_match, scan_filter_no_match,
		scan_connecting_error, scan_connecting);

static void discovery_completed_cb(struct bt_gatt_dm *dm,
				   void *context)
{
	int err;

	printk("The discovery procedure succeeded\n");

	bt_gatt_dm_data_print(dm);

	err = bt_joybus_handles_assign(dm, &joy);
	if (err) {
		printk("Could not init JOY client object, error: %d\n", err);
	}

	if (bt_joy_input_rsp_notify_supported(&joy)) {
		err = bt_joybus_subscribe_input_rsp(&joy,
						     notify_input_rsp_cb);
		if (err) {
			printk("Cannot subscribe to input_response notification "
				"(err: %d)\n", err);
			/* Continue anyway */
		}
	} else {
		err = input_rsp_start_periodic_read(
			&joy, BAS_READ_VALUE_INTERVAL, read_input_response_cb);
		if (err) {
			printk("Could not start periodic read of JOY value\n");
		}
	}

	err = bt_joy_button_enable_indicate(&joy, app_button_indicated_cb);
	if (err) {
		printk("Cannot subscribe to button indications (err: %d)\n", err);
		/* Continue anyway */
	}

	bt_connected = true;


	err = bt_gatt_dm_data_release(dm);
	if (err) {
		printk("Could not release the discovery data, error "
		       "code: %d\n", err);
	}
}

static void discovery_service_not_found_cb(struct bt_conn *conn,
					   void *context)
{
	printk("The service could not be found during the discovery\n");
}

static void discovery_error_found_cb(struct bt_conn *conn,
				     int err,
				     void *context)
{
	printk("The discovery procedure failed with %d\n", err);
}

static struct bt_gatt_dm_cb discovery_cb = {
	.completed = discovery_completed_cb,
	.service_not_found = discovery_service_not_found_cb,
	.error_found = discovery_error_found_cb,
};

static void gatt_discover(struct bt_conn *conn)
{
	int err;

	if (conn != default_conn) {
		return;
	}

	err = bt_gatt_dm_start(conn, BT_UUID_JOYBUS, &discovery_cb, NULL);
	if (err) {
		printk("Could not start the discovery procedure, error "
		       "code: %d\n", err);
	}
}

static void connected(struct bt_conn *conn, uint8_t conn_err)
{
	int err;
	char addr[BT_ADDR_LE_STR_LEN];

	bt_addr_le_to_str(bt_conn_get_dst(conn), addr, sizeof(addr));

	if (conn_err) {
		printk("Failed to connect to %s (%u)\n", addr, conn_err);
		if (conn == default_conn) {
			bt_conn_unref(default_conn);
			default_conn = NULL;

			/* This demo doesn't require active scan */
			err = bt_scan_start(BT_SCAN_TYPE_SCAN_ACTIVE);
			if (err) {
				printk("Scanning failed to start (err %d)\n",
				       err);
			}
		}

		return;
	}
	else {
		printk("Connected: %s - starting discovery...\n", addr);
		gatt_discover(conn);
	}
	

}

static void disconnected(struct bt_conn *conn, uint8_t reason)
{
	char addr[BT_ADDR_LE_STR_LEN];
	int err;

	bt_addr_le_to_str(bt_conn_get_dst(conn), addr, sizeof(addr));

	printk("Disconnected: %s (reason %u)\n", addr, reason);

	if (default_conn != conn) {
		return;
	}

	bt_conn_unref(default_conn);
	default_conn = NULL;

	bt_connected = false;

	/* This demo doesn't require active scan */
	err = bt_scan_start(BT_SCAN_TYPE_SCAN_ACTIVE);
	if (err) {
		printk("Scanning failed to start (err %d)\n", err);
	}
}



BT_CONN_CB_DEFINE(conn_callbacks) = {
	.connected = connected,
	.disconnected = disconnected,
	
};

static void scan_init(void)
{
	int err;

	struct bt_scan_init_param scan_init = {
		.connect_if_match = 1,
		.scan_param = NULL,
		.conn_param = BT_LE_JOYBUS_CONN_PARAMS,
	};

	bt_scan_init(&scan_init);
	bt_scan_cb_register(&scan_cb);

	err = bt_scan_filter_add(BT_SCAN_FILTER_TYPE_UUID, BT_UUID_JOYBUS);
	if (err) {
		printk("Scanning filters cannot be set (err %d)\n", err);

		return;
	}

	err = bt_scan_filter_enable(BT_SCAN_UUID_FILTER, false);
	if (err) {
		printk("Filters cannot be turned on (err %d)\n", err);
	}
}

static void notify_input_rsp_cb(struct bt_joybus_client *joy,
				    uint32_t input_response)
{
	
	uint32_t *rsp_p = &input_response;

	if (input_response == BT_INPUT_RESPONSE_VAL_INVALID) {
		printk("Input Response notification aborted\n");
		
	} else {
		printk("Input Response notification: %x \n", input_response);
		k_msgq_put(&uart_queue, rsp_p, K_NO_WAIT);
	}
}

static void read_input_response_cb(struct bt_joybus_client *joy,
				  uint32_t input_response,
				  int err)
{
	char addr[BT_ADDR_LE_STR_LEN];

	bt_addr_le_to_str(bt_conn_get_dst(bt_joybus_conn(joy)),
			  addr, sizeof(addr));
	if (err) {
		printk("[%s] Input Response read ERROR: %d\n", addr, err);
		return;
	}

	printk("[%s] Input Response read: %x \n", addr, input_response);
}

static void app_button_indicated_cb(struct bt_joybus_client *joy, uint8_t button_state)
{
	char addr[BT_ADDR_LE_STR_LEN];

	bt_addr_le_to_str(bt_conn_get_dst(bt_joybus_conn(joy)), addr, sizeof(addr));

	if(button_state < 0)//invalid value is -1
	{
		printk("Invalid button_state indication received from %s.", addr);
	}
	else {
		printk("[%s] Button %s \n", addr, (button_state ? "Pressed" : "Released"));
	}
}


static void button_handler(uint32_t button_state, uint32_t has_changed)
{
	if(bt_joybus_conn(&joy) != default_conn){
		printk("Not connected, cannot write to LED.\n");
		return;
	}
	
	led_write_state = button_state & has_changed;

	k_work_submit_to_queue(&offload_work_q, &my_work.work);
}


void main(void)
{
	int err;
	uint8_t *rsp_tx_p = 0;

	printk("Starting Bluetooth Central JOY example\n");

	bt_joybus_client_init(&joy);

	err = bt_enable(NULL);
	if (err) {
		printk("Bluetooth init failed (err %d)\n", err);
		return;
	}

	printk("Bluetooth initialized\n");

	if (IS_ENABLED(CONFIG_SETTINGS)) {
		settings_load();
	}

	scan_init();

	err = dk_buttons_init(button_handler);
	if (err) {
		printk("Failed to initialize buttons (err %d)\n", err);
		return;
	}

	k_work_queue_start(&offload_work_q, my_stack_area,
                   K_THREAD_STACK_SIZEOF(my_stack_area), WORKQ_PRIORITY,
                   NULL);

	strcpy(my_work.name, "Thread0 emulate_work()");
	k_work_init(&my_work.work, offload_function);

	err = bt_scan_start(BT_SCAN_TYPE_SCAN_ACTIVE);
	if (err) {
		printk("Scanning failed to start (err %d)\n", err);
		return;
	}

	printk("Scanning successfully started\n");

	while(1)
	{
		k_msgq_get(&uart_queue, rsp_tx_p, K_FOREVER);
		while(bt_connected)
		{
			uart_tx(uart, rsp_tx_p, UART_TX_BUFF_SIZE, 100);
		}
	}
}
```

## src/joybus_client.c
```c
/*
 * Copyright (c) 2019 Nordic Semiconductor ASA
 *
 * SPDX-License-Identifier: LicenseRef-Nordic-5-Clause
 */
#include <zephyr/kernel.h>
#include <zephyr/bluetooth/conn.h>
#include <zephyr/bluetooth/uuid.h>
#include <zephyr/bluetooth/gatt.h>

#include "joybus_client.h"

#include <zephyr/logging/log.h>

LOG_MODULE_REGISTER(joybus_client, 3);

/**
 * @brief Process input response notification
 *
 * Internal function to process report notification and pass it further.
 *
 * @param conn   Connection handler.
 * @param params Notification parameters structure - the pointer
 *               to the structure provided to subscribe function.
 * @param data   Pointer to the data buffer.
 * @param length The size of the received data.
 *
 * @retval BT_GATT_ITER_STOP     Stop notification
 * @retval BT_GATT_ITER_CONTINUE Continue notification
 */
static uint8_t notify_process(struct bt_conn *conn,
			   struct bt_gatt_subscribe_params *params,
			   const void *data, uint16_t length)
{
	struct bt_joybus_client *joy;
	uint32_t input_response;
	const uint32_t* rsp_data = data;
	

	joy = CONTAINER_OF(params, struct bt_joybus_client, input_rsp_notify_params);
	if (!data || !length) {
		LOG_INF("Notifications disabled.");
		if (joy->input_rsp_notify_cb) {
			joy->input_rsp_notify_cb(joy, BT_INPUT_RESPONSE_VAL_INVALID);
		}
		return BT_GATT_ITER_STOP;
	}
	if (length != 4) {
		LOG_ERR("Unexpected notification value size.");
		if (joy->input_rsp_notify_cb) {
			joy->input_rsp_notify_cb(joy, BT_INPUT_RESPONSE_VAL_INVALID);
		}
		return BT_GATT_ITER_STOP;
	}

	input_response = *rsp_data;
	
	joy->input_response = input_response;

	if (joy->input_rsp_notify_cb) {
		joy->input_rsp_notify_cb(joy, input_response);
	}

	return BT_GATT_ITER_CONTINUE;
}

/**
 * @brief Process input response value read
 *
 * Internal function to process report read and pass it further.
 *
 * @param conn   Connection handler.
 * @param err    Read ATT error code.
 * @param params Notification parameters structure - the pointer
 *               to the structure provided to read function.
 * @param data   Pointer to the data buffer.
 * @param length The size of the received data.
 *
 * @retval BT_GATT_ITER_STOP     Stop notification
 * @retval BT_GATT_ITER_CONTINUE Continue notification
 */
static uint8_t read_process(struct bt_conn *conn, uint8_t err,
			     struct bt_gatt_read_params *params,
			     const void *data, uint16_t length)
{
	struct bt_joybus_client *joy;
	uint32_t input_response = 0;
	const uint32_t* rsp_data = data;

	joy = CONTAINER_OF(params, struct bt_joybus_client, input_rsp_read_params);

	if (!joy->input_rsp_read_cb) {
		LOG_ERR("No read callback present");
	} else  if (err) {
		LOG_ERR("Read value error: %d", err);
		joy->input_rsp_read_cb(joy,  input_response, err);
	} else if (!data || length != 1) {
		joy->input_rsp_read_cb(joy,  input_response, -EMSGSIZE);
	} else {
		input_response = *rsp_data;
		joy->input_response = input_response;
		joy->input_rsp_read_cb(joy, input_response, err);
		return BT_GATT_ITER_CONTINUE;
	}

	joy->input_rsp_read_cb = NULL;

	return BT_GATT_ITER_STOP;
}

/**
 * @brief Process periodic battery level value read
 *
 * Internal function to process report read and pass it further.
 * And the end the new read request is triggered.
 *
 * @param conn   Connection handler.
 * @param err    Read ATT error code.
 * @param params Notification parameters structure - the pointer
 *               to the structure provided to read function.
 * @param data   Pointer to the data buffer.
 * @param length The size of the received data.
 *
 * @retval BT_GATT_ITER_STOP     Stop notification
 * @retval BT_GATT_ITER_CONTINUE Continue notification
 */
static uint8_t periodic_read_process(struct bt_conn *conn, uint8_t err,
				  struct bt_gatt_read_params *params,
				  const void *data, uint16_t length)
{
	int32_t interval;
	struct bt_joybus_client *joy;
	uint32_t input_response;
	const uint32_t* rsp_data = data;

	joy = CONTAINER_OF(params, struct bt_joybus_client,
			input_rsp_periodic_read.params);

	if (!joy->input_rsp_notify_cb) {
		LOG_ERR("No notification callback present");
	} else  if (err) {
		LOG_ERR("Read value error: %d", err);
	} else if (!data || length != 1) {
		LOG_ERR("Unexpected read value size.");
	} else {
		input_response = *rsp_data;
		if (joy->input_response != input_response) {
			joy->input_response = input_response;
			joy->input_rsp_notify_cb(joy, input_response);
		} else {
			/* Do nothing. */
		}
	}

	interval = atomic_get(&joy->input_rsp_periodic_read.interval);
	if (interval) {
		k_work_schedule(&joy->input_rsp_periodic_read.read_work,
				K_MSEC(interval));
	}
	return BT_GATT_ITER_STOP;
}

/**
 * @brief Process joybus button press indications
 *
 * Internal function to process indication and pass it further.
 *
 * @param conn   Connection handler.
 * @param err    Read ATT error code.
 * @param params Notification parameters structure - the pointer
 *               to the structure provided to read function.
 * @param data   Pointer to the data buffer.
 * @param length The size of the received data.
 *
 * @retval BT_GATT_ITER_STOP     Stop notification
 * @retval BT_GATT_ITER_CONTINUE Continue notification
 */
static uint8_t button_indicate_process(struct bt_conn *conn,
				      struct bt_gatt_subscribe_params *params,
				      const void *data, uint16_t length)
{
	struct bt_joybus_client *joy;
	uint8_t button_state;
	const uint8_t* button_state_p = data;
	joy = CONTAINER_OF(params, struct bt_joybus_client, button_indicate_params);

	if (!data || !length) {
		LOG_INF("Notifications disabled.");
		if (joy->button_indicate_cb) {
			joy->button_indicate_cb(joy, BT_INPUT_RESPONSE_VAL_INVALID);
		}
		return BT_GATT_ITER_STOP;
	}
	if (length != 1) {
		LOG_ERR("Unexpected notification value size.");
		if (joy->button_indicate_cb) {
			joy->button_indicate_cb(joy, BT_INPUT_RESPONSE_VAL_INVALID);
		}
		return BT_GATT_ITER_STOP;
	}

	button_state = *button_state_p;
	joy->button_state = button_state;

	if (joy->button_indicate_cb) {
		joy->button_indicate_cb(joy, button_state);
	}
	else {
		LOG_DBG("No indicate callback present");
		return BT_GATT_ITER_STOP;
	}

	return BT_GATT_ITER_CONTINUE;

}


/**
 * @brief Periodic read workqueue handler.
 *
 * @param work Work instance.
 */
static void joybus_input_rsp_value_handler(struct k_work *work)
{
	int err;
	struct bt_joybus_client *joy;

	joy = CONTAINER_OF(work, struct bt_joybus_client,
			     input_rsp_periodic_read.read_work);

	if (!atomic_get(&joy->input_rsp_periodic_read.interval)) {
		/* disabled */
		return;
	}

	if (!joy->conn) {
		LOG_ERR("No connection object.");
		return;
	}

	joy->input_rsp_periodic_read.params.func = periodic_read_process;
	joy->input_rsp_periodic_read.params.handle_count  = 1;
	joy->input_rsp_periodic_read.params.single.handle = joy->input_rsp_val_handle;
	joy->input_rsp_periodic_read.params.single.offset = 0;

	err = bt_gatt_read(joy->conn, &joy->input_rsp_periodic_read.params);

	/* Do not treats reading after disconnection as error.
	 * Periodic read process is stopped after disconnection.
	 */
	if (err) {
		LOG_ERR("Periodic Imput Response characteristic read error: %d",
			err);
	}
}


/**
 * @brief Reinitialize the JOY Client.
 *
 * @param joy JOY Client object.
 */
static void joybus_reinit(struct bt_joybus_client *joy)
{
	joy->input_rsp_ccc_handle = 0;
	joy->input_rsp_val_handle = 0;
	joy->input_response = 0;
	joy->conn = NULL;
	joy->input_rsp_notify_cb = NULL;
	joy->input_rsp_read_cb = NULL;
	joy->input_rsp_notify = false;

	joy->button_ccc_handle = 0;
	joy->button_state_handle = 0;
	joy->button_state = 0;
	joy->button_indicate = false;
	joy->button_indicate_cb = NULL;

	joy->led_state_handle = 0;
}


void bt_joybus_client_init(struct bt_joybus_client *joy)
{
	memset(joy, 0, sizeof(*joy));
	joy->input_response = 0;

	k_work_init_delayable(&joy->input_rsp_periodic_read.read_work,
			      joybus_input_rsp_value_handler);
}


int bt_joybus_handles_assign(struct bt_gatt_dm *dm,
				 struct bt_joybus_client *joy)
{
	const struct bt_gatt_dm_attr *gatt_service_attr =
			bt_gatt_dm_service_get(dm);
	const struct bt_gatt_service_val *gatt_service =
			bt_gatt_dm_attr_service_val(gatt_service_attr);
	const struct bt_gatt_dm_attr *gatt_chrc;
	const struct bt_gatt_dm_attr *gatt_desc;
	const struct bt_gatt_chrc *chrc_val;

	if (bt_uuid_cmp(gatt_service->uuid, BT_UUID_JOYBUS)) {
		return -ENOTSUP;
	}
	LOG_DBG("Getting handles from joybus service.");

	/* If connection is established again, cancel previous read request. */
	k_work_cancel_delayable(&joy->input_rsp_periodic_read.read_work);
	/* When workqueue is used its instance cannont be cleared. */
	joybus_reinit(joy);

	/* Input Response characteristic */
	gatt_chrc = bt_gatt_dm_char_by_uuid(dm, BT_UUID_JOYBUS_INPUT_RESP);
	if (!gatt_chrc) {
		LOG_ERR("No Input Response characteristic found.");
		return -EINVAL;
	}
	chrc_val = bt_gatt_dm_attr_chrc_val(gatt_chrc);
	__ASSERT_NO_MSG(chrc_val); /* This is internal function and it has to
				    * be called with characteristic attribute
				    */
	joy->input_rsp_properties = chrc_val->properties;
	
	gatt_desc = bt_gatt_dm_desc_by_uuid(dm, gatt_chrc,
					    BT_UUID_JOYBUS_INPUT_RESP);
	if (!gatt_desc) {
		LOG_ERR("No Input Response characteristic value found.");
		return -EINVAL;
	}
	joy->input_rsp_val_handle = gatt_desc->handle;

	gatt_desc = bt_gatt_dm_desc_by_uuid(dm, gatt_chrc, BT_UUID_GATT_CCC);
	if (!gatt_desc) {
		LOG_INF("No battery CCC descriptor found. Battery service do not supported notification.");
	} else {
		joy->input_rsp_notify = true;
		joy->input_rsp_ccc_handle = gatt_desc->handle;
	}

	//Button Characteristic w/ CCCD
	gatt_chrc = bt_gatt_dm_char_by_uuid(dm, BT_UUID_JOYBUS_BUTTON);
	if (!gatt_chrc) {
		LOG_ERR("No Button characteristic found.");
		return -EINVAL;
	}
	chrc_val = bt_gatt_dm_attr_chrc_val(gatt_chrc);
	__ASSERT_NO_MSG(chrc_val); /* This is internal function and it has to
				    * be called with characteristic attribute
				    */
	joy->button_properties = chrc_val->properties;
	
	gatt_desc = bt_gatt_dm_desc_by_uuid(dm, gatt_chrc,
					    BT_UUID_JOYBUS_BUTTON);
	if (!gatt_desc) {
		LOG_ERR("No Button characteristic value found.");
		return -EINVAL;
	}
	joy->button_state_handle = gatt_desc->handle;
	joy->button_indicate_params.value_handle = gatt_desc->handle;

	gatt_desc = bt_gatt_dm_desc_by_uuid(dm, gatt_chrc, BT_UUID_GATT_CCC);
	if (!gatt_desc) {
		LOG_INF("No Button CCC descriptor found.");
	} else {
		joy->button_indicate = true;
		joy->button_ccc_handle = gatt_desc->handle;
		joy->button_indicate_params.ccc_handle = gatt_desc->handle;
		
	}

	//LED Characteristic
	gatt_chrc = bt_gatt_dm_char_by_uuid(dm, BT_UUID_JOYBUS_LED);
	if (!gatt_chrc) {
		LOG_ERR("No LED characteristic found.");
		return -EINVAL;
	}
	chrc_val = bt_gatt_dm_attr_chrc_val(gatt_chrc);
	__ASSERT_NO_MSG(chrc_val); /* This is internal function and it has to
				    * be called with characteristic attribute
				    */
	joy->led_properties = chrc_val->properties;
	
	gatt_desc = bt_gatt_dm_desc_by_uuid(dm, gatt_chrc,
					    BT_UUID_JOYBUS_LED);
	if (!gatt_desc) {
		LOG_ERR("No LED characteristic value found.");
		return -EINVAL;
	}
	joy->led_state_handle = gatt_desc->handle;

	/* Finally - save connection object */
	joy->conn = bt_gatt_dm_conn_get(dm);
	return 0;
}

int bt_joybus_subscribe_input_rsp(struct bt_joybus_client *joy,
				   bt_input_rsp_notify_cb func)
{
	int err;

	if (!joy || !func) {
		return -EINVAL;
	}
	if (!joy->conn) {
		return -EINVAL;
	}
	if (!(joy->input_rsp_properties & BT_GATT_CHRC_NOTIFY)) {
		return -ENOTSUP;
	}
	if (joy->input_rsp_notify_cb) {
		return -EALREADY;
	}

	joy->input_rsp_notify_cb = func;

	joy->input_rsp_notify_params.notify = notify_process;
	joy->input_rsp_notify_params.value = BT_GATT_CCC_NOTIFY;
	joy->input_rsp_notify_params.value_handle = joy->input_rsp_val_handle;
	joy->input_rsp_notify_params.ccc_handle = joy->input_rsp_ccc_handle;
	atomic_set_bit(joy->input_rsp_notify_params.flags,
		       BT_GATT_SUBSCRIBE_FLAG_VOLATILE);

	LOG_DBG("Subscribe: val: %u, ccc: %u",
		joy->input_rsp_notify_params.value_handle,
		joy->input_rsp_notify_params.ccc_handle);
	err = bt_gatt_subscribe(joy->conn, &joy->input_rsp_notify_params);
	if (err) {
		LOG_ERR("Report notification subscribe error: %d.", err);
		joy->input_rsp_notify_cb = NULL;
		return err;
	}
	LOG_DBG("Report subscribed.");
	return err;
}


int bt_joybus_unsubscribe_input_rsp(struct bt_joybus_client *joy)
{
	int err;

	if (!joy) {
		return -EINVAL;
	}

	if (!joy->input_rsp_notify_cb) {
		return -EFAULT;
	}

	err = bt_gatt_unsubscribe(joy->conn, &joy->input_rsp_notify_params);
	joy->input_rsp_notify_cb = NULL;
	return err;
}

int bt_joy_button_enable_indicate(struct bt_joybus_client *joy, bt_button_indicate_cb func)
{
	
	int err;

	if (!joy || !func) {
		return -EINVAL;
	}
	if (!joy->conn) {
		return -EINVAL;
	}
	if (!(joy->button_properties & BT_GATT_CHRC_INDICATE)) {
		return -ENOTSUP;
	}
	if (joy->button_indicate_cb) {
		return -EALREADY;
	}

	joy->button_indicate_cb = func;
	joy->button_indicate_params.value = BT_GATT_CCC_INDICATE;
	joy->button_indicate_params.value_handle = joy->button_state_handle;
	joy->button_indicate_params.ccc_handle = joy->button_ccc_handle;
	joy->button_indicate_params.notify = button_indicate_process;

	atomic_set_bit(joy->button_indicate_params.flags,
		       BT_GATT_SUBSCRIBE_FLAG_VOLATILE);

	LOG_DBG("Subscribe: val: %u, ccc: %u",
		joy->button_indicate_params.value_handle,
		joy->button_indicate_params.ccc_handle);
	err = bt_gatt_subscribe(joy->conn, &joy->button_indicate_params);
	if (err) {
		LOG_ERR("Report indication subscribe error: %d.", err);
		joy->button_indicate_cb = NULL;
		return err;
	}
	LOG_DBG("Report subscribed.");
	return err;


}

struct bt_conn *bt_joybus_conn(const struct bt_joybus_client *joy)
{
	return joy->conn;
}


int bt_joybus_read_input_rsp(struct bt_joybus_client *joy, bt_input_rsp_read_cb func)
{
	int err;

	if (!joy || !func) {
		return -EINVAL;
	}
	if (!joy->conn) {
		return -EINVAL;
	}
	if (joy->input_rsp_read_cb) {
		return -EBUSY;
	}
	joy->input_rsp_read_cb = func;
	joy->input_rsp_read_params.func = read_process;
	joy->input_rsp_read_params.handle_count  = 1;
	joy->input_rsp_read_params.single.handle = joy->input_rsp_val_handle;
	joy->input_rsp_read_params.single.offset = 0;

	err = bt_gatt_read(joy->conn, &joy->input_rsp_read_params);
	if (err) {
		joy->input_rsp_read_cb = NULL;
		return err;
	}
	return 0;
}


int bt_joybus_get_input_rsp(struct bt_joybus_client *joy)
{
	if (!joy) {
		return -EINVAL;
	}

	return joy->input_response;
}


int input_rsp_start_periodic_read(struct bt_joybus_client *joy,
					int32_t interval,
					bt_input_rsp_read_cb func)
{
	if (!joy || !func || !interval) {
		return -EINVAL;
	}

	if (bt_joy_input_rsp_notify_supported(joy)) {
		return -ENOTSUP;
	}

	joy->input_rsp_read_cb = func;
	atomic_set(&joy->input_rsp_periodic_read.interval, interval);
	k_work_schedule(&joy->input_rsp_periodic_read.read_work, K_MSEC(interval));

	return 0;
}


void input_rsp_stop_periodic_read(struct bt_joybus_client *joy)
{
	/* If read is proccesed now, prevent triggering new
	 * characteristic read.
	 */
	atomic_set(&joy->input_rsp_periodic_read.interval, 0);

	/* If delayed workqueue pending, cancel it. If this fails, we'll exit
	 * early in the read handler due to the interval.
	 */
	k_work_cancel_delayable(&joy->input_rsp_periodic_read.read_work);
}

void led_write_cb(struct bt_conn *conn, uint8_t err,
				     struct bt_gatt_write_params *params){
	//Do nothing
}

void joybus_led_write(struct bt_joybus_client *joy, uint32_t led_state){
	
	int err;

	joy->led_write_params.func = led_write_cb;
	joy->led_write_params.handle = joy->led_state_handle;
	joy->led_write_params.data = &led_state;
	joy->led_write_params.length = 1;
	joy->led_write_params.offset = 0;

	err = bt_gatt_write(joy->conn, &joy->led_write_params);
	if(err){
		LOG_ERR("Failed to write to LED Characteristic (err %d)", err);
	}
	else {
		LOG_INF("Sent LED GATT write: %d", led_state);
	}
}
```
