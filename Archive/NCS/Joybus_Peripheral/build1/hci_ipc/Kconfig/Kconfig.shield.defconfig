## Archive/NCS/Joybus_Peripheral/build1/hci_ipc/Kconfig/Kconfig.shield.defconfig
```kconfig
osource "c:/users/ralls/github/rarebit-flags-receivers/boards/shields/*/Kconfig.defconfig"
osource "c:/ncs/v2.9.1/zephyr/boards/shields/*/Kconfig.defconfig"
osource "C:/ncs/v2.9.1/nrf/boards/shields/*/Kconfig.defconfig"
```

## Archive/NCS/Serial1_central_blejoybus/buildNaN/Serial1_central_blejoybus/Kconfig/Kconfig.shield
```kconfig
osource "C:/Users/ralls/GitHub/rareBit-Flags-Receivers/boards/shields/*/Kconfig.shield"
osource "C:/ncs/v2.9.1/nrf/boards/shields/*/Kconfig.shield"
```

## Cont_Resp_Capture/build/Kconfig/boards/Kconfig.defconfig
```kconfig
# Load Zephyr board defconfig descriptions.
osource "C:/ncs/v2.9.1/zephyr/boards/nordic/nrf5340dk/Kconfig.defconfig"
```

## Joybus_Central/build1/Kconfig/Kconfig.shield.defconfig
```kconfig
osource "C:/Users/ralls/GitHub/rareBit-Flags-Receivers/boards/shields/*/Kconfig.defconfig"
osource "C:/ncs/v2.9.1/nrf/boards/shields/*/Kconfig.defconfig"
```

## Serial1_central_blejoybus/build1/Kconfig/Kconfig.shield
```kconfig
osource "c:/users/ralls/github/bluetooth-n64-controller/serial1_periph_blejoybus/boards/shields/*/Kconfig.shield"
osource "C:/ncs/v2.3.0/nrf/boards/shields/*/Kconfig.shield"
```

## Serial1_central_blejoybus/build1/Kconfig/Kconfig.shield.defconfig
```kconfig
osource "c:/users/ralls/github/bluetooth-n64-controller/serial1_periph_blejoybus/boards/shields/*/Kconfig.defconfig"
osource "C:/ncs/v2.3.0/nrf/boards/shields/*/Kconfig.defconfig"
```

## Serial1_periph_blejoybus/build1/hci_ipc/Kconfig/Kconfig.shield
```kconfig
osource "c:/users/ralls/github/rarebit-flags-receivers/boards/shields/*/Kconfig.shield"
osource "c:/ncs/v2.9.1/zephyr/boards/shields/*/Kconfig.shield"
osource "c:/users/ralls/github/bluetooth-n64-controller/serial1_periph_blejoybus/boards/shields/*/Kconfig.shield"
osource "C:/ncs/v2.9.1/nrf/boards/shields/*/Kconfig.shield"
```
