## CMakeLists.txt
```
cmake_minimum_required(VERSION 3.20.0)

if(DEFINED CUSTOM_BOILERPLATE)
    include(${CUSTOM_BOILERPLATE})
    return()
endif()

set(COMMON_PATH C:/ncs/v2.9.1/modules/hal/nordic/nrfx/samples/common)
include(${COMMON_PATH}/common.cmake)

GET_DEVICE_CONFIG_FILES(${BOARD} ../boards)

find_package(Zephyr REQUIRED HINTS $ENV{ZEPHYR_BASE})
project(nrfx_example)
target_sources(app PRIVATE 
src/main.c 
src/joybus.c
)
target_include_directories(app PRIVATE C:/ncs/v2.9.1/modules/hal/nordic/nrfx/samples/common)
```

## prj.conf
```kconfig
CONFIG_NRFX_TIMER0=y
CONFIG_GPIO=n
CONFIG_NRFX_GPIOTE0=y

# Bluetooth LE
CONFIG_BT=y
CONFIG_BT_PERIPHERAL=y
CONFIG_BT_DEVICE_NAME="JOYBUS_TRANSPORT"
CONFIG_BT_USER_PHY_UPDATE=y
CONFIG_BT_MAX_CONN=2

# Increase stack size for the main thread and System Workqueue
CONFIG_SYSTEM_WORKQUEUE_STACK_SIZE=8192
CONFIG_MAIN_STACK_SIZE=8192
CONFIG_HEAP_MEM_POOL_SIZE=4096
CONFIG_LOG_PROCESS_THREAD=y
```

## src/main.c
```c
//#include <nrfx_example.h>
#include <helpers/nrfx_gppi.h>
#include <nrfx_timer.h>
#include <nrfx_gpiote.h>
#if NRFX_CLOCK_ENABLED && (defined(CLOCK_FEATURE_HFCLK_DIVIDE_PRESENT) || NRF_CLOCK_HAS_HFCLK192M)
#include <nrfx_clock.h>
#endif

#include <zephyr/bluetooth/bluetooth.h>
#include <zephyr/bluetooth/gap.h>
#include <zephyr/bluetooth/uuid.h>
#include <zephyr/bluetooth/conn.h>

#include "joybus.h"

#include <zephyr/sys/printk.h>


/** @brief Symbol specifying timer instance to be used. */
#define TIMER_INST_IDX 0

/** @brief Symbol specifying GPIOTE instance to be used. */
#define GPIOTE_INST_IDX 0

/** @brief Symbol specifying ouput pin associated with the task. */
#define INPUT_PIN1 9
#define INPUT_PIN2 8

#define DEVICE_NAME CONFIG_BT_DEVICE_NAME
#define DEVICE_NAME_LEN (sizeof(DEVICE_NAME) - 1)

bool bt_connected = false;
static bool app_button_state;

nrfx_gpiote_t const gpiote_inst = NRFX_GPIOTE_INSTANCE(GPIOTE_INST_IDX);
nrfx_timer_t timer_inst = NRFX_TIMER_INSTANCE(TIMER_INST_IDX);

static uint8_t period_channel;
static uint8_t pw_channel;
static uint8_t gppi_channel_period;
static uint8_t gppi_channel_pw;

static uint32_t cont_resp = 0;

static uint8_t bit_count = 0;

bool print_f = false;

static const struct bt_data ad[] = {
	BT_DATA_BYTES(BT_DATA_FLAGS, (BT_LE_AD_GENERAL | BT_LE_AD_NO_BREDR)),
	BT_DATA(BT_DATA_NAME_COMPLETE, DEVICE_NAME, DEVICE_NAME_LEN),

};

static const struct bt_data sd[] = {
	BT_DATA_BYTES(BT_DATA_UUID128_ALL, BT_UUID_JOYBUS_VAL),
};


static const struct bt_le_adv_param *adv_param = BT_LE_ADV_PARAM(
	(BT_LE_ADV_OPT_CONNECTABLE |
	 BT_LE_ADV_OPT_USE_IDENTITY), /* Connectable advertising and use identity address */
	800, /* Min Advertising Interval 500ms (800*0.625ms) */
	801, /* Max Advertising Interval 500.625ms (801*0.625ms) */
	NULL); /* Set to NULL for undirected advertising */

static void update_phy(struct bt_conn *conn)
{
	int err;
	const struct bt_conn_le_phy_param preferred_phy = {
		.options = BT_CONN_LE_PHY_OPT_NONE,
		.pref_rx_phy = BT_GAP_LE_PHY_2M,
		.pref_tx_phy = BT_GAP_LE_PHY_2M,
	};
	err = bt_conn_le_phy_update(conn, &preferred_phy);
	if (err) {
		printk("bt_conn_le_phy_update() returned %d", err);
	}
}


static void on_connected(struct bt_conn *conn, uint8_t conn_err)
{
	int err;

	if (conn_err) {
		printk("Connection failed (err %u)\n", conn_err);
		return;
	}

	struct bt_conn_info info;
	err = bt_conn_get_info(conn, &info);
	if (err) {
		printk("bt_conn_get_info() returned %d", err);
		return;
	}

	double connection_interval = info.le.interval * 1.25; // in ms
	uint16_t supervision_timeout = info.le.timeout * 10; // in ms
	printk("Connection parameters: interval %e ms, latency %d intervals, timeout %d ms",
		connection_interval, info.le.latency, supervision_timeout);

	update_phy(conn);

	bt_connected = true;

}

void on_le_phy_updated(struct bt_conn *conn, struct bt_conn_le_phy_info *param)
{
	// PHY Updated
	if (param->tx_phy == BT_CONN_LE_TX_POWER_PHY_1M) {
		printk("PHY updated. New PHY: 1M");
	} else if (param->tx_phy == BT_CONN_LE_TX_POWER_PHY_2M) {
		printk("PHY updated. New PHY: 2M");
	} else if (param->tx_phy == BT_CONN_LE_TX_POWER_PHY_CODED_S8) {
		printk("PHY updated. New PHY: Long Range");
	}
}

static void on_disconnected(struct bt_conn *conn, uint8_t reason)
{
	printk("Disconnected (reason %u)\n", reason);

	bt_connected = false;

}

struct bt_conn_cb connection_callbacks = {
	.connected = on_connected,
	.disconnected = on_disconnected,
	.le_phy_updated = on_le_phy_updated,
};


static void bit_capture_handler(nrfx_gpiote_pin_t pin, nrfx_gpiote_trigger_t trigger, void *p_context)
{
    if(timer_inst.p_reg->CC[0] > 32) cont_resp |= (1<< (31-bit_count));
    else                             cont_resp &= ~(1<<(31-bit_count));                            
    
    bit_count++;

    //TODO Synchronize here
    if(bit_count >= 32)
    {
        bit_count = 0;
        print_f = true;
    } 

}

static void app_led_cb(bool led_state)
{
	
}

static bool app_button_cb(void)
{
	return app_button_state;
}

static struct joybus_cb app_callbacks = {
	.led_cb = app_led_cb,
	.button_cb = app_button_cb,
};

static void app_gpiote_init()
{
    nrfx_err_t status;
    (void)status;

    
    status = nrfx_gpiote_init(&gpiote_inst, NRFX_GPIOTE_DEFAULT_CONFIG_IRQ_PRIORITY);
    NRFX_ASSERT(status == NRFX_SUCCESS);
    printk("GPIOTE status: %s\n",
                   nrfx_gpiote_init_check(&gpiote_inst) ? "initialized" : "not initialized");

    status = nrfx_gpiote_channel_alloc(&gpiote_inst, &period_channel);
    NRFX_ASSERT(status == NRFX_SUCCESS);

    static const nrfx_gpiote_handler_config_t handler_config = {
        .handler = bit_capture_handler
    };

    static const nrfx_gpiote_trigger_config_t period_trigger_config = {
        .p_in_channel = &period_channel,
        .trigger      = NRFX_GPIOTE_TRIGGER_LOTOHI
    };

    static const nrfx_gpiote_input_pin_config_t period_config = 
    {
        .p_handler_config = &handler_config,
        .p_pull_config    = (nrf_gpio_pin_pull_t *) NRF_GPIO_PIN_NOPULL,
        .p_trigger_config = &period_trigger_config
    };


    nrfx_gpiote_input_configure(&gpiote_inst, INPUT_PIN1, &period_config);
    nrfx_gpiote_trigger_enable(&gpiote_inst, INPUT_PIN1, true);
    

    status = nrfx_gpiote_channel_alloc(&gpiote_inst, &pw_channel);
    NRFX_ASSERT(status == NRFX_SUCCESS);

    static const nrfx_gpiote_trigger_config_t pw_trigger_config = {
        .p_in_channel = &pw_channel,
        .trigger      = NRFX_GPIOTE_TRIGGER_HITOLO
    };

    static const nrfx_gpiote_input_pin_config_t pw_config = 
    {
        .p_handler_config = NULL,//&handler_config,
        .p_pull_config    = (nrf_gpio_pin_pull_t *) NRF_GPIO_PIN_NOPULL,
        .p_trigger_config = &pw_trigger_config
    };

    nrfx_gpiote_input_configure(&gpiote_inst, INPUT_PIN2, &pw_config);
    nrfx_gpiote_trigger_enable(&gpiote_inst, INPUT_PIN2, false);
}

static void app_timer_init()
{
    nrfx_err_t status;
    (void)status;

    
    uint32_t base_frequency = NRF_TIMER_BASE_FREQUENCY_16MHZ;
    nrfx_timer_config_t timer_config = NRFX_TIMER_DEFAULT_CONFIG(base_frequency);
    timer_config.bit_width = NRF_TIMER_BIT_WIDTH_32;
    timer_config.p_context = "Some context";

    status = nrfx_timer_init(&timer_inst, &timer_config, NULL);//SWR come back here for the timer handler to develop further
    if(status != NRFX_SUCCESS)
    {
        printk("Error Timer Init No: %d\n", status);
        
        k_msleep(1000);
        return;
    }
    else
        printk("Timer Initialized\n");

    nrfx_timer_clear(&timer_inst);
}

static void app_gppi_setup()
{
    nrfx_err_t status;
    (void)status;

    status = nrfx_gppi_channel_alloc(&gppi_channel_period);
    NRFX_ASSERT(status == NRFX_SUCCESS);

    /*
     * Use this to start the timer on the rising edge
     */
    nrfx_gppi_channel_endpoints_setup(gppi_channel_period,
        nrfx_gpiote_in_event_address_get(&gpiote_inst, INPUT_PIN1),
        nrfx_timer_task_address_get(&timer_inst, NRF_TIMER_TASK_CLEAR));

    nrfx_gppi_channels_enable(BIT(gppi_channel_period));

    status = nrfx_gppi_channel_alloc(&gppi_channel_pw);
    NRFX_ASSERT(status == NRFX_SUCCESS);

    /*
     * Use this for capturing the timer count on the falling edge to measure the pulse width
     */
    nrfx_gppi_channel_endpoints_setup(gppi_channel_pw,
        nrfx_gpiote_in_event_address_get(&gpiote_inst, INPUT_PIN2),
        nrfx_timer_capture_task_address_get(&timer_inst, NRF_TIMER_CC_CHANNEL0));

    nrfx_gppi_channels_enable(BIT(gppi_channel_pw));

    printk("GPPI channels setup and enabled\n");
}


int main(void)
{
    
    printk("Starting nrfx_gppi pulse width sketch.\n");

    #if defined(__ZEPHYR__)
        IRQ_CONNECT(NRFX_IRQ_NUMBER_GET(NRF_TIMER_INST_GET(TIMER_INST_IDX)), IRQ_PRIO_LOWEST,
                    NRFX_TIMER_INST_HANDLER_GET(TIMER_INST_IDX), 0, 0);
        IRQ_CONNECT(NRFX_IRQ_NUMBER_GET(NRF_GPIOTE_INST_GET(GPIOTE_INST_IDX)), IRQ_PRIO_LOWEST,
                    NRFX_GPIOTE_INST_HANDLER_GET(GPIOTE_INST_IDX), 0, 0);
    #endif

    printk("Connected Interrupts.\n");

    //FAST AF BOOOII
    #if NRFX_CLOCK_ENABLED && (defined(CLOCK_FEATURE_HFCLK_DIVIDE_PRESENT) || NRF_CLOCK_HAS_HFCLK192M)
	    nrfx_clock_divider_set(NRF_CLOCK_DOMAIN_HFCLK, NRF_CLOCK_HFCLK_DIV_1);
    #endif

    int err;
    
    app_timer_init();

    app_gpiote_init();

    app_gppi_setup();
 
    nrfx_timer_enable(&timer_inst);
    
    printk("Timer status: %s\n", nrfx_timer_is_enabled(&timer_inst) ? "enabled" : "disabled");
    

    err = bt_enable(NULL);
	if (err) {
		printk("Bluetooth init failed (err %d)\n", err);
		return -1;
	}

	err = bt_conn_cb_register(&connection_callbacks);
    if (err) {
		printk("Bluetooth callbacks failed to register. (err %d)\n", err);
		return -1;
	}

	err = joybus_init(&app_callbacks);
	if (err) {
		printk("Failed to init Joybus (err:%d)\n", err);
		return -1;
	}
	printk("Bluetooth initialized\n");
    

	err = bt_le_adv_start(adv_param, ad, ARRAY_SIZE(ad), sd, ARRAY_SIZE(sd));
	if (err) {
		printk("Advertising failed to start (err %d)\n", err);
		return -1;
	}

    printk("Started Advertising....\n");
    k_msleep(1500);

    printk("Enter Main Loop....\n");


    while (1)
    {

        //TODO build the main loop out

        //Generate Poll

        //Start the pulse width timer

        //wait for the gppi to build the controller response ~200uS

        //send the controller response over BT

        if(print_f)
        {
            printk("PERIPHERAL: %x\n", cont_resp);

            if(bt_connected)
            {
                /* Send notification, the function sends notifications only if a client is subscribed */
                err = joybus_send_input_response_notify(cont_resp);
                if(err)
                {
                    printk("Error sending controller response. Err: %d\n", err);
                }
            }
            
            print_f = false;
        }
        k_msleep(2);

    }

    return 0;

}

/** @} */
```

## src/joybus.h
```c
/*
 * Copyright (c) 2018 Nordic Semiconductor ASA
 *
 * SPDX-License-Identifier: LicenseRef-Nordic-5-Clause
 */

#ifndef BT_LBS_H_
#define BT_LBS_H_

/**@file
 * @defgroup bt_lbs LED Button Service API
 * @{
 * @brief API for the LED Button Service (LBS).
 */

#ifdef __cplusplus
extern "C" {
#endif

#include <zephyr/types.h>

/** @brief JOYBUS Service UUID. */
#define BT_UUID_JOYBUS_VAL BT_UUID_128_ENCODE(0x9c0cf328, 0x5dde, 0xefde, 0x47e6, 0x917590558b99)

/** @brief Button Characteristic UUID. */
#define BT_UUID_JOYBUS_BUTTON_VAL                                                                     \
	BT_UUID_128_ENCODE(0x9c0cf329, 0x5dde, 0xefde, 0x47e6, 0x917590558b99)

/** @brief LED Characteristic UUID. */
#define BT_UUID_JOYBUS_LED_VAL BT_UUID_128_ENCODE(0x9c0cf32a, 0x5dde, 0xefde, 0x47e6, 0x917590558b99)

/** @brief INPUT RESPONSE Characteristic UUID. */
#define BT_UUID_JOYBUS_INPUT_RESP_VAL                                                                   \
	BT_UUID_128_ENCODE(0x9c0cf32b, 0x5dde, 0xefde, 0x47e6, 0x917590558b99)

#define BT_UUID_JOYBUS BT_UUID_DECLARE_128(BT_UUID_JOYBUS_VAL)
#define BT_UUID_JOYBUS_BUTTON BT_UUID_DECLARE_128(BT_UUID_JOYBUS_BUTTON_VAL)
#define BT_UUID_JOYBUS_LED BT_UUID_DECLARE_128(BT_UUID_JOYBUS_LED_VAL)

#define BT_UUID_JOYBUS_INPUT_RESP BT_UUID_DECLARE_128(BT_UUID_JOYBUS_INPUT_RESP_VAL)

/** @brief Callback type for when an LED state change is received. */
typedef void (*led_cb_t)(const bool led_state);

/** @brief Callback type for when the button state is pulled. */
typedef bool (*button_cb_t)(void);

/** @brief Callback struct used by the LBS Service. */
struct joybus_cb {
	/** LED state change callback. */
	led_cb_t led_cb;
	/** Button read callback. */
	button_cb_t button_cb;
};

/** @brief Initialize the LBS Service.
 *
 * This function registers application callback functions with the My LBS
 * Service
 *
 * @param[in] callbacks Struct containing pointers to callback functions
 *			used by the service. This pointer can be NULL
 *			if no callback functions are defined.
 *
 *
 * @retval 0 If the operation was successful.
 *           Otherwise, a (negative) error code is returned.
 */
int joybus_init(struct joybus_cb *callbacks);

/** @brief Send the button state as indication.
 *
 * This function sends a binary state, typically the state of a
 * button, to all connected peers.
 *
 * @param[in] button_state The state of the button.
 *
 * @retval 0 If the operation was successful.
 *           Otherwise, a (negative) error code is returned.
 */
int joybus_send_button_state_indicate(bool button_state);

/** @brief Send the button state as notification.
 *
 * This function sends a binary state, typically the state of a
 * button, to all connected peers.
 *
 * @param[in] button_state The state of the button.
 *
 * @retval 0 If the operation was successful.
 *           Otherwise, a (negative) error code is returned.
 */
int joybus_send_button_state_notify(bool button_state);

/** @brief Send the sensor value as notification.
 *
 * This function sends an uint32_t  value, typically the value
 * of a simulated sensor to all connected peers.
 *
 * @param[in] sensor_value The value of the simulated sensor.
 *
 * @retval 0 If the operation was successful.
 *           Otherwise, a (negative) error code is returned.
 */
int joybus_send_input_response_notify(uint32_t sensor_value);

#ifdef __cplusplus
}
#endif

/**
 * @}
 */

#endif /* BT_LBS_H_ */
```
